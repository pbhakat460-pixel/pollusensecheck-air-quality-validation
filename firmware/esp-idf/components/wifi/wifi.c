/******************************************************************************
 * File Name   : wifi.c
 * Project     : PolluSense
 * Description :
 * Implements the Wi-Fi Station (STA) module for the PolluSense system.
 *
 * This module is responsible for:
 *   - Initializing the ESP-IDF Wi-Fi subsystem.
 *   - Connecting to the configured Wi-Fi network.
 *   - Handling Wi-Fi and IP events.
 *   - Automatically reconnecting after disconnection.
 *   - Reporting connection status to the application.
 ******************************************************************************/

#include "wifi.h"

#include <string.h>

#include "esp_log.h"

#include "esp_wifi.h"
#include "esp_event.h"
#include "esp_netif.h"
#include "nvs_flash.h"
#include "esp_sntp.h"
#include <time.h>
#include <sys/time.h>
#include "freertos/FreeRTOS.h"
#include "freertos/event_groups.h"

/* Wi-Fi credentials used by the ESP32 station */
#define WIFI_SSID      "Research Project"
#define WIFI_PASSWORD  "Project@nit123"

/* Logging tag */
static const char *TAG = "WIFI";

/* FreeRTOS event group used for Wi-Fi synchronization */
static EventGroupHandle_t wifi_event_group;

/* Event bit indicating successful Wi-Fi connection */
#define WIFI_CONNECTED_BIT BIT0

/* Internal Wi-Fi connection status */
static bool wifi_connected = false;

/* Public Wi-Fi connection status flag */
static bool s_wifi_connected = false;

/******************************************************************************
 * Function    : wifi_is_connected
 *
 * Description :
 * Returns the current Wi-Fi connection status.
 *
 * Parameters  : None
 *
 * Returns
 *      true  -> Connected
 *      false -> Not connected
 ******************************************************************************/
bool wifi_is_connected(void)
{
    return s_wifi_connected;
}

/******************************************************************************
 * Function    : wifi_event_handler
 *
 * Description :
 * Handles Wi-Fi and IP events generated by the ESP-IDF event loop.
 *
 * Events Handled:
 *   - Station started.
 *   - Station disconnected.
 *   - IP address assigned.
 *
 * Parameters
 *      arg        : User argument (unused).
 *      event_base : Event source.
 *      event_id   : Event identifier.
 *      event_data : Event-specific data.
 *
 * Returns
 *      None
 ******************************************************************************/
static void wifi_event_handler(
    void *arg,
    esp_event_base_t event_base,
    int32_t event_id,
    void *event_data)
{
    /* Wi-Fi station has started */
    if (event_base == WIFI_EVENT &&
        event_id == WIFI_EVENT_STA_START)
    {
        ESP_LOGI(TAG, "Connecting to WiFi...");

        /* Start connection attempt */
        esp_wifi_connect();
    }

    /* Wi-Fi connection lost */
    else if (event_base == WIFI_EVENT &&
             event_id == WIFI_EVENT_STA_DISCONNECTED)
    {
        /* Update connection status */
        wifi_connected = false;

        ESP_LOGW(TAG, "Disconnected. Reconnecting...");

        /* Automatically reconnect */
        esp_wifi_connect();
    }

    /* Successfully obtained an IP address */
    else if (event_base == IP_EVENT &&
             event_id == IP_EVENT_STA_GOT_IP)
    {
        /* Access IP information */
        ip_event_got_ip_t *event =
            (ip_event_got_ip_t *)event_data;

        /* Display assigned IP address */
        ESP_LOGI(TAG,
                 "Got IP: " IPSTR,
                 IP2STR(&event->ip_info.ip));

        /* Mark Wi-Fi as connected */
        wifi_connected = true;

        /* Notify waiting tasks */
        xEventGroupSetBits(
            wifi_event_group,
            WIFI_CONNECTED_BIT);
    }
}
/******************************************************************************
 * Synchronize Time using NTP
 ******************************************************************************/
static void obtain_time(void)
{
    ESP_LOGI(TAG, "Starting NTP...");

    setenv("TZ", "IST-5:30", 1);
    tzset();

    esp_sntp_setoperatingmode(SNTP_OPMODE_POLL);
    esp_sntp_setservername(0, "pool.ntp.org");
    esp_sntp_init();

    time_t now = 0;
    struct tm timeinfo = {0};

    int retry = 0;
    const int retry_count = 15;

    while (timeinfo.tm_year < (2024 - 1900) &&
           ++retry < retry_count)
    {
        ESP_LOGI(TAG, "Waiting for NTP sync... (%d/%d)",
                 retry, retry_count);

        vTaskDelay(pdMS_TO_TICKS(2000));

        time(&now);
        localtime_r(&now, &timeinfo);
    }

    if (timeinfo.tm_year >= (2024 - 1900))
    {
        char buffer[64];

        strftime(buffer,
                 sizeof(buffer),
                 "%d-%m-%Y %H:%M:%S",
                 &timeinfo);

        ESP_LOGI(TAG,
                 "Current Time : %s",
                 buffer);
    }
    else
    {
        ESP_LOGW(TAG,
                 "NTP synchronization failed");
    }
}
/******************************************************************************
 * Function    : wifi_init
 *
 * Description :
 * Initializes the complete Wi-Fi Station interface.
 *
 * Initialization Steps:
 *   1. Initialize NVS.
 *   2. Create Event Group.
 *   3. Initialize TCP/IP stack.
 *   4. Create default event loop.
 *   5. Create Wi-Fi station interface.
 *   6. Initialize Wi-Fi driver.
 *   7. Register event handlers.
 *   8. Configure SSID and password.
 *   9. Start Wi-Fi.
 *  10. Wait until connected.
 *
 * Parameters  : None
 *
 * Returns
 *      ESP_OK on successful connection.
 *      ESP_FAIL on timeout.
 ******************************************************************************/
esp_err_t wifi_init(void)
{
    /* Variable used for ESP-IDF return codes */
    esp_err_t ret;

    /* Initialize Non-Volatile Storage */
    ESP_LOGI(TAG, "Initializing NVS...");

    ret = nvs_flash_init();

    /* Recover if NVS requires formatting */
    if (ret == ESP_ERR_NVS_NO_FREE_PAGES ||
        ret == ESP_ERR_NVS_NEW_VERSION_FOUND)
    {
        ESP_ERROR_CHECK(nvs_flash_erase());
        ret = nvs_flash_init();
    }

    ESP_ERROR_CHECK(ret);

    /* Create the Wi-Fi synchronization event group */
    wifi_event_group = xEventGroupCreate();

    ESP_LOGI(TAG, "Creating Network Interface");

    /* Initialize the TCP/IP network stack */
    ESP_ERROR_CHECK(esp_netif_init());

    /* Create the default event loop */
    ESP_ERROR_CHECK(esp_event_loop_create_default());

    /* Create the default Wi-Fi Station interface */
    esp_netif_create_default_wifi_sta();

    /* Obtain the default Wi-Fi configuration */
    wifi_init_config_t cfg = WIFI_INIT_CONFIG_DEFAULT();

    /* Initialize the Wi-Fi driver */
    ESP_ERROR_CHECK(esp_wifi_init(&cfg));

    /* Register Wi-Fi event handler */
    ESP_ERROR_CHECK(
        esp_event_handler_register(
            WIFI_EVENT,
            ESP_EVENT_ANY_ID,
            &wifi_event_handler,
            NULL));

    /* Register IP event handler */
    ESP_ERROR_CHECK(
        esp_event_handler_register(
            IP_EVENT,
            IP_EVENT_STA_GOT_IP,
            &wifi_event_handler,
            NULL));

    /* Configure Wi-Fi Station credentials */
    wifi_config_t wifi_config = {
        .sta = {
            .ssid = WIFI_SSID,
            .password = WIFI_PASSWORD,
            .threshold.authmode = WIFI_AUTH_WPA2_PSK,
        },
    };

    /* Configure Station mode */
    ESP_ERROR_CHECK(
        esp_wifi_set_mode(WIFI_MODE_STA));

    /* Apply Wi-Fi configuration */
    ESP_ERROR_CHECK(
        esp_wifi_set_config(
            WIFI_IF_STA,
            &wifi_config));

    /* Start the Wi-Fi driver */
    ESP_ERROR_CHECK(
        esp_wifi_start());

    ESP_LOGI(TAG, "Waiting for WiFi connection...");

    /* Wait until an IP address is obtained or timeout occurs */
    EventBits_t bits =
        xEventGroupWaitBits(
            wifi_event_group,
            WIFI_CONNECTED_BIT,
            pdFALSE,
            pdTRUE,
            pdMS_TO_TICKS(20000));

    /* Check whether connection succeeded */
    if (bits & WIFI_CONNECTED_BIT)
    {
        ESP_LOGI(TAG, "WiFi Connected");

        obtain_time();

        return ESP_OK;
    }

    /* Connection timeout */
    ESP_LOGE(TAG, "WiFi Connection Timeout");

    return ESP_FAIL;
}